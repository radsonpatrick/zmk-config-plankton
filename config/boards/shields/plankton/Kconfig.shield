## config/boards/shields/plankton/Kconfig.shield
```kconfig
# Copyright (c) 2021 The ZMK Contributors
# SPDX-License-Identifier: MIT

config SHIELD_PLANKTON
    def_bool $(shields_list_contains,plankton)
```
